## examples/ml307_usb_net_demo/main/Kconfig.projbuild
```kconfig
menu "ML307 USB link test"
    config VOICE_TEST_ECM
        bool "Use ECM instead of priority RNDIS"
        default n
    config VOICE_TEST_APN
        string "SIM APN; empty preserves modem configuration"
        default ""
    config VOICE_TEST_AUTO_MODE_CHANGE
        bool "Allow one persistent USB mode change and modem reboot on startup"
        default n
        help
            Enable only for a separate USB test after baseline calls finish.
            Default query-only mode never changes USB personality or reboots.
    config VOICE_TEST_UART_BAUD
        int "Current modem UART baud"
        default 921600
endmenu
```

## examples/ml307_usb_net_demo/sdkconfig.defaults
```kconfig
CONFIG_IDF_TARGET="esp32s3"
CONFIG_ESPTOOLPY_FLASHSIZE_8MB=y
CONFIG_ESP_CONSOLE_UART_DEFAULT=y
CONFIG_ESP_CONSOLE_SECONDARY_NONE=y
CONFIG_FREERTOS_HZ=1000
CONFIG_LOG_COLORS=n
CONFIG_USB_HOST_CONTROL_TRANSFER_MAX_SIZE=512
CONFIG_USBH_CDC_CONTROL_TRANSFER_BUFFER_SIZE=1025
CONFIG_LWIP_IPV6=n
CONFIG_LWIP_UDP_RECVMBOX_SIZE=8
CONFIG_LWIP_TCPIP_RECVMBOX_SIZE=16
CONFIG_USB_HOST_HUBS_SUPPORTED=y
```

## examples/radar_uart_demo/sdkconfig.defaults
```kconfig
CONFIG_IDF_TARGET="esp32s3"
CONFIG_ESPTOOLPY_FLASHSIZE_8MB=y
CONFIG_ESPTOOLPY_FLASHMODE_DIO=y
CONFIG_ESPTOOLPY_FLASHFREQ_80M=y
CONFIG_PARTITION_TABLE_CUSTOM=y
CONFIG_PARTITION_TABLE_CUSTOM_FILENAME="../../partitions.csv"
CONFIG_ESP_CONSOLE_UART_DEFAULT=y
CONFIG_ESP_CONSOLE_UART_BAUDRATE=115200
CONFIG_ESP_MAIN_TASK_STACK_SIZE=4096
```

## main/Kconfig.projbuild
```kconfig
menu "Voice intercom options"

config VOICE_ML307_USB_OBSERVER
    bool "Debug only: observe ML307 USB normal / Dump enumeration"
    depends on IDF_TARGET_ESP32S3 && ESP_CONSOLE_SECONDARY_NONE
    default n
    help
        Reserve GPIO19/20 for the module USB D-/D+. Observe standard USB
        descriptors and disconnects while keeping the UART17/18 transport.
        No USB AT commands, diagnostic activation, media or module resets.
        Disable the USB Serial/JTAG secondary console in this debug build.
        Leave disabled in normal firmware and on boards using these pins.

config VOICE_STATUS_INDICATOR_ENABLE
    bool "Include V7 mainboard RGB status LED (GPIO39, WS2812B-2020-V6)"
    depends on IDF_TARGET_ESP32S3
    default n
    help
        For the V7 indicator revision only. Local status pulses show MQTT
        readiness and call state. Uses no modem commands or media queues.
        Leave disabled on boards that use GPIO39 for other peripherals/JTAG.

config VOICE_POWER_MONITOR_ENABLE
    bool "Include V6 mainboard supply / battery monitor"
    depends on IDF_TARGET_ESP32S3
    default n
    help
        For the V6 integrated UPS board only. GPIO47 reads the power mux ST,
        GPIO10 detects external input, ADC1/GPIO2 measures the gated battery
        divider (GPIO9). GPIO48/1 read charger status; GPIO38 pauses charging
        while ringing, calling or updating. No modem commands during calls.
        Leave disabled on development boards without these circuits.

config VOICE_RADAR_ENABLE
    bool "Include optional presence / vitals radar"
    depends on IDF_TARGET_ESP32S3
    default n
    help
        Compile the optional receive-only radar and separate telemetry into the
        voice firmware. Uses UART2 RX on GPIO6 at 115200 baud. GPIO8 stays
        an undriven input. No automatic call actions or call protocol changes.
        When disabled, radar sources and entry points are omitted entirely.

config VOICE_RADAR_R60
    bool "Use R60ABD1 60 GHz vitals model"
    depends on VOICE_RADAR_ENABLE
    default n
    help
        Decode confirmed R60ABD1 breathing, heart rate, motion and distance.
        Disabled keeps the 24 GHz presence mode. Sleep remains a raw enum.

endmenu
```

## tests/firmware/ml307c-usb-enumerate/main/Kconfig.projbuild
```kconfig
menu "ML307C diagnostic probe"

config ML307C_PROBE_ENABLE_DUMP_SAVE
    bool "Enable documented ML307C crash Dump saving during this diagnostic run"
    default n
    help
        After confirming the expected module version and querying MDUMPCFG,
        send AT+MDUMPCFG=1 and read it back. This changes the module's crash
        recovery behavior. It does not enable continuous AP/CP logging.
        Keep disabled in the default read-only enumeration build.

endmenu
```

## tests/firmware/ml307c-usb-enumerate/sdkconfig.defaults
```kconfig
CONFIG_ESPTOOLPY_FLASHSIZE_8MB=y
CONFIG_ESP_CONSOLE_UART_DEFAULT=y
CONFIG_ESP_CONSOLE_SECONDARY_NONE=y
CONFIG_USB_HOST_CONTROL_TRANSFER_MAX_SIZE=4096
CONFIG_ESP_MAIN_TASK_STACK_SIZE=6144
```
